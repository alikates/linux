## Documentation/devicetree/bindings/leds/leds-qcom-spmi-flash.yaml
```yaml
# SPDX-License-Identifier: (GPL-2.0 OR BSD-2-Clause)
%YAML 1.2
---
$id: http://devicetree.org/schemas/leds/leds-qcom-spmi-flash.yaml#
$schema: http://devicetree.org/meta-schemas/core.yaml#

title: Qualcomm SPMI Flash LEDs

maintainers:
  - Nícolas F. R. A. Prado <nfraprado@protonmail.com>

description: |
  The Qualcomm SPMI Flash LEDs are part of Qualcomm PMICs and are used primarily
  as a camera or video flash. They can also be used as a lantern when on torch
  mode.
  The PMIC is connected to Host processor via SPMI bus.

properties:
  compatible:
    const: qcom,spmi-flash

  reg:
    maxItems: 1

  flash-boost-supply:
    description: SMBB regulator for LED flash mode

  torch-boost-supply:
    description: SMBB regulator for LED torch mode

patternProperties:
  "^led[0-1]$":
    type: object
    $ref: common.yaml#

    properties:
      qcom,clamp-curr:
        description: current to clamp at, in uA
        $ref: /schemas/types.yaml#definitions/uint32

      qcom,headroom:
        description: |
          headroom to use. Use one of QCOM_SPMI_FLASH_HEADROOM_* defined in
          include/dt-bindings/leds/leds-qcom-spmi-flash.h
        $ref: /schemas/types.yaml#definitions/uint32
        minimum: 0
        maximum: 3

      qcom,startup-dly:
        description: |
          delay before flashing. Use one of QCOM_SPMI_FLASH_STARTUP_DLY_*
          defined in include/dt-bindings/leds/leds-qcom-spmi-flash.h
        $ref: /schemas/types.yaml#definitions/uint32
        minimum: 0
        maximum: 3

      qcom,safety-timer:
        description: include for safety timer use, otherwise watchdog timer will be used
        type: boolean

required:
  - compatible
  - reg
  - flash-boost-supply
  - torch-boost-supply

additionalProperties: false

examples:
  - |
    #include <dt-bindings/leds/common.h>
    #include <dt-bindings/leds/leds-qcom-spmi-flash.h>

    qcom,leds@d300 {
        compatible = "qcom,spmi-flash";
        reg = <0xd300 0x100>;
        flash-boost-supply = <&pm8941_5vs1>;
        torch-boost-supply = <&pm8941_5v>;

        led0 {
            led-sources = <0>;
            function = LED_FUNCTION_FLASH;
            color = <LED_COLOR_ID_WHITE>;
            led-max-microamp = <200000>;
            flash-max-microamp = <1000000>;
            flash-max-timeout-us = <1280000>;
            default-state = "off";
            qcom,clamp-curr = <200000>;
            qcom,headroom = <QCOM_SPMI_FLASH_HEADROOM_500MV>;
            qcom,startup-dly = <QCOM_SPMI_FLASH_STARTUP_DLY_128US>;
            qcom,safety-timer;
        };
    };
...
```
